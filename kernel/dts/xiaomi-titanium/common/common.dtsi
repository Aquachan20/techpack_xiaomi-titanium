#include "android.dtsi"
#include "soc.dtsi"
#include "cpu.dtsi"
#include "spi.dtsi"
#include "sdhc.dtsi"
#include "pinctrl.dtsi"
#include "audio.dtsi"
#include "haptic.dtsi"
#include "display.dtsi"
#include "regulator.dtsi"